## boards/shields/roBa/Kconfig.defconfig
```kconfig
if SHIELD_ROBA_L || SHIELD_ROBA_R
    config ZMK_KEYBOARD_NAME
        default "roBa"

    config NFCT_PINS_AS_GPIOS
        default y

    config ZMK_SPLIT
        default y

    config ZMK_POINTING
        default y
endif
```
